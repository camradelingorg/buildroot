## package/modbusgw/Config.in
```kconfig
config BR2_PACKAGE_MODBUS_GATEWAY
    bool "modbusgw"
    depends on BR2_PACKAGE_MXML
    help
      Modbus Gateway utility
```

## package/rtl88XX-special/Config.in
```kconfig
config BR2_PACKAGE_RTL88XX_SPECIAL
	bool "rtl8812/14 aircrack"
	depends on BR2_LINUX_KERNEL
	help
	  rtl8812au wifi driver

comment "rtl8812/14 needs a Linux kernel to be built"
	depends on !BR2_LINUX_KERNEL
```

## package/stlink/Config.in
```kconfig
config BR2_PACKAGE_STLINK
	bool "stlink"
	select BR2_PACKAGE_LIBUSB
	help
	  Open source version of the STMicroelectronics ST-LINK Tools
```
